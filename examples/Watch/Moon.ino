// Moon display: shows APPROXIMATE phase of moon.  This is not a medical
// device -- do not rely on this data if you are prone to lycanthropy.
// The phase shown is based on time elapsed since a known new moon, an
// approach that the Arduino can easily process but may be limited by a
// few flaws: the "known new moon" time is based on UTC, not local time,
// and may be a few hours off; the lunar period is assumed uniform and
// is rounded to whole seconds, and thus may drift over very long periods;
// unknown long-term accuracy of RTClib (e.g. DST & leap seconds ignored);
// uses 32-bit unixtime() and thus likely innacurate in years 2038+.
// This is for fun, not Real Science(tm).

static const uint8_t PROGMEM
 phases[] = {
  0x3B,0x1F,0x01,0x00,0x3E,0x26,0x03,0x00,0x3F,0x2E,0x06,0x00,0x42,0x3E,0x07,
  0x00,0x47,0x56,0x07,0x00,0x54,0x7A,0x07,0x00,0x81,0x88,0x07,0x00,0xCC,0x88,
  0x07,0x00,0xF2,0x88,0x07,0x00,0xF2,0x84,0x06,0x00,0xF0,0x77,0x03,0x00,0xED,
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  0x01,0x00 },
 leftHalf[]  = { 0, 0,  0,  0,  0,  0,  0,  0, 15, 14, 13, 12, 11, 10, 9,
                 8, 8,  8,  8,  8,  8,  8,  8,  7,  6,  5,  4,  3,  2, 1 },
 rightHalf[] = { 0, 1,  2,  3,  4,  5,  6,  7,  8,  8,  8,  8,  8,  8, 8,
                 8, 9, 10, 11, 12, 13, 14, 15,  0,  0,  0,  0,  0,  0, 0 };

// Time/date of a known new moon (UNIX time) - Dec 7 1999 22:32
#define NEW_MOON 944605920
#define LP       2551443L // Lunar period in seconds

uint8_t phase = 0;

void mode_moon(uint8_t action) {

  if(action != ACTION_NONE) {
    // If we just arrived here (whether through mode change
    // or wake from sleep), initialize the matrix driver:
    if(action >= ACTION_HOLD_LEFT) {
      uint8_t depth = 6, plex = LED_PLEX_4;
      // Reduce depth/plex if battery voltage is low
      if(watch.getmV() < BATT_LOW_MV) {
        depth = 2;
        plex  = LED_PLEX_1;
      }
      // Reconfigure display if needed
      if((watch.getDepth() != depth) || (watch.getPlex() != plex))
        fps = watch.setDisplayMode(depth, plex, true);

      DateTime now = RTC.now();
      phase = (uint8_t) (((now.unixtime() - NEW_MOON) % LP) / (24L * 3600L));
    }
    // Reset sleep timeout on ANY button action
    watch.setTimeout(fps * 3);
  }

  uint16_t t = watch.getTimeout();
  uint8_t  b = (t < sizeof(fade)) ? (uint8_t)pgm_read_byte(&fade[t]) : 255;

  watch.fillScreen(0);
  blit(phases, 64, 8, pgm_read_byte(&rightHalf[phase]) * 4 ,0, 4, 0, 4, 8, b );
  watch.setRotation(2);
  blit(phases, 64, 8, pgm_read_byte(&leftHalf[phase])  * 4 ,0, 4, 0, 4, 8, b );
  watch.setRotation(0);
}

