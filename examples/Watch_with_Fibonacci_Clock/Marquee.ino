// Scrolling marquee time/date display.

static const uint8_t PROGMEM
 marqueeDigits[] = {
  0x00,0x00,0x2C,0xDA,0xEB,0x16,0x00,0x0B,0xFF,0x00,0x2C,0xDA,0xD7,0x16,0x00,
  0x2C,0xD1,0xDF,0x16,0x00,0x00,0x00,0x14,0xDC,0x00,0xFF,0xFF,0xFF,0xDF,0x00,
  0x2C,0xDA,0xEB,0x44,0x00,0xFF,0xFF,0xFF,0xDF,0x00,0x2C,0xDA,0xD7,0x16,0x00,
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  0x0D,0x64,0x0D,0x00,0x00,0x00 },
 digitX[]     = { 1, 6, 9, 14, 19, 24, 29, 34, 39, 44, 49, 53, 55, 59 },
 digitWidth[] = { 5, 3, 5,  5,  5,  5,  5,  5,  5,  5,  4,  2,  4,  4 };

// Extra symbols after digits 0-9
#define SYM_SLASH 10
#define SYM_COLON 11
#define SYM_AM    12
#define SYM_PM    13

#define MARQUEE_SUBMODE_TIME 0
#define MARQUEE_SUBMODE_DATE 1

static int8_t
  marqueeSubmode = MARQUEE_SUBMODE_TIME,
  f              = 0,
  len            = 0,
  str[8]; // Time 'string' (non-ASCII)

void mode_marquee(uint8_t action) {
  DateTime now;
  uint8_t  i, dx, dw, y, h;
  int      x, sum;

  if(action != ACTION_NONE) {

    // If we just arrived here (whether through mode change
    // or wake from sleep), initialize the matrix driver:
    if(action >= ACTION_HOLD_LEFT) {
      uint8_t depth = 7, plex = LED_PLEX_4;
      // Reduce depth/plex if battery voltage is low
      if(watch.getmV() < BATT_LOW_MV) {
        depth = 2;
        plex  = LED_PLEX_1;
      }
      // Reconfigure display if needed
      if((watch.getDepth() != depth) || (watch.getPlex() != plex))
        fps = watch.setDisplayMode(depth, plex, true);
      // And begin in time-display mode:
      marqueeSubmode = MARQUEE_SUBMODE_TIME;
    } else if(action == ACTION_TAP_LEFT) {
      if(++marqueeSubmode > MARQUEE_SUBMODE_DATE)
        marqueeSubmode = MARQUEE_SUBMODE_TIME;
    } else if(action == ACTION_TAP_RIGHT) {
      if(--marqueeSubmode < MARQUEE_SUBMODE_TIME)
        marqueeSubmode = MARQUEE_SUBMODE_DATE;
    }

    // Load time/date digits depending on current submode:
    now = RTC.now();
    len = 0;
    if(marqueeSubmode == MARQUEE_SUBMODE_TIME) {
      i = now.hour(); // 0-23
      if(h24) {
        loadDigits(i, DIGIT_HR0);
        str[len++] = digit[DIGIT_HR0];
      } else {
        if(i > 12)      i -= 12;
        else if(i == 0) i  = 12;
        loadDigits(i, DIGIT_HR0);
        if(i >= 10) str[len++] = 1;
      }
      str[len++] = digit[DIGIT_HR1];
      str[len++] = SYM_COLON;
      loadDigits(now.minute(), DIGIT_MIN0);
      str[len++] = digit[DIGIT_MIN0];
      str[len++] = digit[DIGIT_MIN1];
      if(!h24) str[len++] = (now.hour() < 12) ? SYM_AM : SYM_PM;
    } else {
      loadDigits(now.year() - 2000, DIGIT_YEAR0);
      loadDigits(now.month()      , DIGIT_MON0);
      loadDigits(now.day()        , DIGIT_DAY0);
      if(digit[DIGIT_MON0] > 0) str[len++] = digit[DIGIT_MON0];
      str[len++] = digit[DIGIT_MON1];
      str[len++] = SYM_SLASH;
      if(digit[DIGIT_DAY0] > 0) str[len++] = digit[DIGIT_DAY0];
      str[len++] = digit[DIGIT_DAY1];
      str[len++] = SYM_SLASH;
      str[len++] = digit[DIGIT_YEAR0];
      str[len++] = digit[DIGIT_YEAR1];
    }

    sum = 0;
    for(i=0; i<len; i++) sum += pgm_read_byte(&digitWidth[str[i]]);
    // When in power-reduced mode, blitting happens quicker because
    // of fewer screen bits; scale the timeout to compensate.
    if(watch.getPlex() != LED_PLEX_4) sum *= 3;

    // Reset sleep timeout on ANY button action
    watch.setTimeout((sum + 8) * 4); // Sleep after time/date scrolls off left edge

    curX = 8; // Initialize position off right edge
    f    = 0;
  }

  watch.fillScreen(0);
  x = curX;
  h = 8 - (f * 2); // Height of upper section of character to blit (2-8)
  y = f * 8;       // Vertical position of character in marqueeDigits[].
  // There are actually 4 bitmaps of each digit, each offset by 1/4 pixel
  // to provide subpixel antialiasing when scrolling -- extra smoothness!
  for(i=0; i<len; i++) {
    dx = pgm_read_byte(&digitX[str[i]]);
    dw = pgm_read_byte(&digitWidth[str[i]]);
    // The blit() function doesn't do real compositing -- it overwrites.
    // In order to pack the italicized digits closer together, they're
    // blitted as an upper and lower half (offset by 1 pixel) that don't
    // overlap the prior character.
    blit(          marqueeDigits, 63, 32, dx  , y  , x  , 0, dw, h  , 255 );
    if(h < 8) blit(marqueeDigits, 63, 32, dx-1, y+h, x-1, h, dw, 8-h, 255 );
    x += pgm_read_byte(&digitWidth[str[i]]);
  }

  // Every 4th frame, move left 1 pixel.  X is not reset or wrapped here...
  // timeout will kick in, and X will be set on the next wake operation.
  if(++f >= 4) {
    curX--;
    f = 0;
  }
}

